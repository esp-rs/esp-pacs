# ESP32-S2 register map
Vendor: ESPRESSIF SYSTEMS (SHANGHAI) CO., LTD.; Series: ESP32 S-Series; File version: 20
CPU: Xtensa LX7 r0p0, little endian, no MPU, no FPU, 0 interrupt priority bits
Address unit: 32 bits
Registers are 32-bit, read-write, reset 0x0 unless marked. A register's access mark holds for its fields unless they carry their own. Offsets are from the block's base; [hi:lo] are bit positions; {n}, {i} and the like mark numbered series.

## AES — AES (Advanced Encryption Standard) Accelerator
Base 0x6003A000
{0x0+4i} KEY_{i} (i=0..7) — AES key register {i}
  [31:0] KEY — Stores AES keys.
{0x20+4i} TEXT_IN_{i} (i=0..3) — Source data register {i}
  [31:0] TEXT_IN — Stores the source data when the AES Accelerator operates in the Typical AES working mode.
{0x30+4i} TEXT_OUT_{i} (i=0..3) — Result data register {i}
  [31:0] TEXT_OUT — Stores the result data when the AES Accelerator operates in the Typical AES working mode.
0x40 MODE — AES working mode configuration register
  [2:0] MODE — Defines the operation type of the AES Accelerator operating under the Typical AES working mode. & 0x0(AES_EN_128): AES-EN-128 # 0x1(AES_EN_192): AES-EN-192 # 0x2(AES_EN_256): AES-EN-256 # 0x4(AES_DE_128): AES-DE-128 # 0x5(AES_DE_192): AES-DE-192 # 0x6(AES_DE_256): AES-DE-256 &
0x44 ENDIAN — Endian configuration register
  [5:0] ENDIAN — Defines the endianness of input and output texts. & [1:0] key endian # [3:2] text_in endian or in_stream endian # [5:4] text_out endian or out_stream endian # &
0x48 TRIGGER wo — Operation start controlling register
  [0] TRIGGER — Set this bit to 1 to start AES operation.
0x4C STATE ro — Operation status register
  [1:0] STATE — Stores the working status of the AES Accelerator. For details, see Table 3 for Typical AES working mode and Table 9 for DMA AES working mode. For typical AES; 0 = idle; 1 = busy. For DMA-AES; 0 = idle; 1 = busy; 2 = calculation_done.
{0x50+4i} IV_{i} (i=0..3) — initialization vector
  [31:0] IV — This register stores the %sth 32-bit piece of 128-bit initialization vector
{0x60+4i} H_{i} (i=0..3) ro — GCM hash subkey
  [31:0] H
{0x70+4i} J0_{i} (i=0..3)
  [31:0] J0 — This register stores the %sth 32-bit piece of 128-bit J0
{0x80+4i} T0_{i} (i=0..3) ro
  [31:0] T0 — This register stores the %sth 32-bit piece of 128-bit T0
0x90 DMA_ENABLE
  [0] DMA_ENABLE — Defines the working mode of the AES Accelerator. For details, see Table 1. 1'h0: typical AES operation 1'h1: DMA-AES operation
0x94 BLOCK_MODE — Block operation type register
  [2:0] BLOCK_MODE — Defines the operation type of the AES Accelerator operating under the DMA-AES working mode. For details, see Table 8. & 3'h0(BLOCK_MODE_ECB): ECB # 3'h1(BLOCK_MODE_CBC): CBC # 3'h2(BLOCK_MODE_OFB): OFB # 3'h3(BLOCK_MODE_CTR): CTR # 3'h4(BLOCK_MODE_CFB8): CFB-8 # 3'h5(BLOCK_MODE_CFB128): CFB-128 # 3'h6(BLOCK_MODE_GCM): GCM &
0x98 BLOCK_NUM — Block number configuration register
  [31:0] BLOCK_NUM — Stores the Block Number of plaintext or cipertext when the AES Accelerator operates under the DMA-AES working mode. For details, see Section 1.5.4.
0x9C INC_SEL — Standard incrementing function register
  [0] INC_SEL — Defines the Standard Incrementing Function for CTR block operation. Set this bit to 0 or 1 to choose INC 32 or INC 128 .
0xA0 AAD_BLOCK_NUM — AAD block number configuration register
  [31:0] AAD_BLOCK_NUM — Stores the ADD Block Number for the GCM operation.
0xA4 REMAINDER_BIT_NUM — Remainder bit number of plaintext/ciphertext
  [6:0] REMAINDER_BIT_NUM — Stores the Remainder Bit Number for the GCM operation.
0xA8 CONTINUE_OP wo — Operation continue controlling register
  [0] CONTINUE_OP — Set this bit to 1 to continue AES operation.
0xAC INT_CLR wo — DMA-AES interrupt clear register
  [0] INT_CLR — Set this bit to 1 to clear AES interrupt.
0xB0 INT_ENA — DMA-AES interrupt enable register
  [0] INT_ENA — Set this bit to 1 to enable AES interrupt and 0 to disable interrupt.
0xB4 DATE reset 0x20190514 — Version control register
  [29:0] DATE
0xB8 DMA_EXIT wo — Operation exit controlling register
  [0] DMA_EXIT — Set this bit to 1 to exit AES operation. This register is only effective for DMA-AES operation.

## Notices in the file
Copyright 2025 Espressif Systems (Shanghai) PTE LTD
Licensed under the Apache License, Version 2.0 (the "License");
you may not use this file except in compliance with the License.
You may obtain a copy of the License at
http://www.apache.org/licenses/LICENSE-2.0
Unless required by applicable law or agreed to in writing, software
distributed under the License is distributed on an "AS IS" BASIS,
WITHOUT WARRANTIES OR CONDITIONS OF ANY KIND, either express or implied.
See the License for the specific language governing permissions and
limitations under the License.
