# ESP32-C5 register map
Vendor: ESPRESSIF SYSTEMS (SHANGHAI) CO., LTD.; Series: ESP32 C-Series; File version: 1
CPU: RV32IMAC r0p0, little endian, no MPU, no FPU, 0 interrupt priority bits
Address unit: 32 bits
Registers are 32-bit, read-write, reset 0x0 unless marked. A register's access mark holds for its fields unless they carry their own. Offsets are from the block's base; [hi:lo] are bit positions; {n}, {i} and the like mark numbered series.

## INTERRUPT_CORE0 — Interrupt Controller (Core 0)
Base 0x60010000
0x00 WIFI_MAC_INTR_MAP — WIFI_MAC_INTR mapping register
  [5:0] WIFI_MAC_INTR_MAP — Configures the interrupt source into one CPU interrupt.
0x04 WIFI_MAC_NMI_MAP — WIFI_MAC_NMI mapping register
  [5:0] WIFI_MAC_NMI_MAP — Configures the interrupt source into one CPU interrupt.
0x08 WIFI_PWR_INTR_MAP — WIFI_PWR_INTR mapping register
  [5:0] WIFI_PWR_INTR_MAP — Configures the interrupt source into one CPU interrupt.
0x0C WIFI_BB_INTR_MAP — WIFI_BB_INTR mapping register
  [5:0] WIFI_BB_INTR_MAP — Configures the interrupt source into one CPU interrupt.
0x10 BT_MAC_INTR_MAP — BT_MAC_INTR mapping register
  [5:0] BT_MAC_INTR_MAP — Configures the interrupt source into one CPU interrupt.
0x14 BT_BB_INTR_MAP — BT_BB_INTR mapping register
  [5:0] BT_BB_INTR_MAP — Configures the interrupt source into one CPU interrupt.
0x18 BT_BB_NMI_MAP — BT_BB_NMI mapping register
  [5:0] BT_BB_NMI_MAP — Configures the interrupt source into one CPU interrupt.
0x1C LP_TIMER_INTR_MAP — LP_TIMER_INTR mapping register
  [5:0] LP_TIMER_INTR_MAP — Configures the interrupt source into one CPU interrupt.
0x20 COEX_INTR_MAP — COEX_INTR mapping register
  [5:0] COEX_INTR_MAP — Configures the interrupt source into one CPU interrupt.
0x24 BLE_TIMER_INTR_MAP — BLE_TIMER_INTR mapping register
  [5:0] BLE_TIMER_INTR_MAP — Configures the interrupt source into one CPU interrupt.
0x28 BLE_SEC_INTR_MAP — BLE_SEC_INTR mapping register
  [5:0] BLE_SEC_INTR_MAP — Configures the interrupt source into one CPU interrupt.
0x2C I2C_MST_INTR_MAP — I2C_MST_INTR mapping register
  [5:0] I2C_MST_INTR_MAP — Configures the interrupt source into one CPU interrupt.
0x30 ZB_MAC_INTR_MAP — ZB_MAC_INTR mapping register
  [5:0] ZB_MAC_INTR_MAP — Configures the interrupt source into one CPU interrupt.
0x34 PMU_INTR_MAP — PMU_INTR mapping register
  [5:0] PMU_INTR_MAP — Configures the interrupt source into one CPU interrupt.
0x38 EFUSE_INTR_MAP — EFUSE_INTR mapping register
  [5:0] EFUSE_INTR_MAP — Configures the interrupt source into one CPU interrupt.
0x3C LP_RTC_TIMER_INTR_MAP — LP_RTC_TIMER_INTR mapping register
  [5:0] LP_RTC_TIMER_INTR_MAP — Configures the interrupt source into one CPU interrupt.
0x40 LP_UART_INTR_MAP — LP_UART_INTR mapping register
  [5:0] LP_UART_INTR_MAP — Configures the interrupt source into one CPU interrupt.
0x44 LP_I2C_INTR_MAP — LP_I2C_INTR mapping register
  [5:0] LP_I2C_INTR_MAP — Configures the interrupt source into one CPU interrupt.
0x48 LP_WDT_INTR_MAP — LP_WDT_INTR mapping register
  [5:0] LP_WDT_INTR_MAP — Configures the interrupt source into one CPU interrupt.
0x4C LP_PERI_TIMEOUT_INTR_MAP — LP_PERI_TIMEOUT_INTR mapping register
  [5:0] LP_PERI_TIMEOUT_INTR_MAP — Configures the interrupt source into one CPU interrupt.
0x50 LP_APM_M0_INTR_MAP — LP_APM_M0_INTR mapping register
  [5:0] LP_APM_M0_INTR_MAP — Configures the interrupt source into one CPU interrupt.
0x54 LP_APM_M1_INTR_MAP — LP_APM_M1_INTR mapping register
  [5:0] LP_APM_M1_INTR_MAP — Configures the interrupt source into one CPU interrupt.
0x58 HUK_INTR_MAP — HUK_INTR mapping register
  [5:0] HUK_INTR_MAP — Configures the interrupt source into one CPU interrupt.
{0x5C+4i} CPU_INTR_FROM_CPU_{i}_MAP (i=0..3) — CPU_INTR_FROM_CPU_{i} mapping register
  [5:0] CPU_INTR_FROM_CPU_{i}_MAP — Configures the interrupt source into one CPU interrupt.
0x6C BUS_MONITOR_INTR_MAP — BUS_MONITOR_INTR mapping register
  [5:0] BUS_MONITOR_INTR_MAP — Configures the interrupt source into one CPU interrupt.
0x70 TRACE_INTR_MAP — TRACE_INTR mapping register
  [5:0] TRACE_INTR_MAP — Configures the interrupt source into one CPU interrupt.
0x74 CACHE_INTR_MAP — CACHE_INTR mapping register
  [5:0] CACHE_INTR_MAP — Configures the interrupt source into one CPU interrupt.
0x78 CPU_PERI_TIMEOUT_INTR_MAP — CPU_PERI_TIMEOUT_INTR mapping register
  [5:0] CPU_PERI_TIMEOUT_INTR_MAP — Configures the interrupt source into one CPU interrupt.
0x7C GPIO_INTERRUPT_PRO_MAP — GPIO_INTERRUPT_PRO mapping register
  [5:0] GPIO_INTERRUPT_PRO_MAP — Configures the interrupt source into one CPU interrupt.
0x80 GPIO_INTERRUPT_EXT_MAP — GPIO_INTERRUPT_EXT mapping register
  [5:0] GPIO_INTERRUPT_EXT_MAP — Configures the interrupt source into one CPU interrupt.
0x84 PAU_INTR_MAP — PAU_INTR mapping register
  [5:0] PAU_INTR_MAP — Configures the interrupt source into one CPU interrupt.
0x88 HP_PERI_TIMEOUT_INTR_MAP — HP_PERI_TIMEOUT_INTR mapping register
  [5:0] HP_PERI_TIMEOUT_INTR_MAP — Configures the interrupt source into one CPU interrupt.
0x8C MODEM_PERI_TIMEOUT_INTR_MAP — MODEM_PERI_TIMEOUT_INTR mapping register
  [5:0] MODEM_PERI_TIMEOUT_INTR_MAP — Configures the interrupt source into one CPU interrupt.
{0x90+4i} HP_APM_M{i}_INTR_MAP (i=0..4) — HP_APM_M{i}_INTR mapping register
  [5:0] HP_APM_M{i}_INTR_MAP — Configures the interrupt source into one CPU interrupt.
0xA4 LP_APM0_INTR_MAP — LP_APM0_INTR mapping register
  [5:0] LP_APM0_INTR_MAP — Configures the interrupt source into one CPU interrupt.
0xA8 MSPI_INTR_MAP — MSPI_INTR mapping register
  [5:0] MSPI_INTR_MAP — Configures the interrupt source into one CPU interrupt.
0xAC I2S_INTR_MAP — I2S_INTR mapping register
  [5:0] I2S_INTR_MAP — Configures the interrupt source into one CPU interrupt.
0xB0 UHCI0_INTR_MAP — UHCI0_INTR mapping register
  [5:0] UHCI0_INTR_MAP — Configures the interrupt source into one CPU interrupt.
0xB4 UART0_INTR_MAP — UART0_INTR mapping register
  [5:0] UART0_INTR_MAP — Configures the interrupt source into one CPU interrupt.
0xB8 UART1_INTR_MAP — UART1_INTR mapping register
  [5:0] UART1_INTR_MAP — Configures the interrupt source into one CPU interrupt.
0xBC LEDC_INTR_MAP — LEDC_INTR mapping register
  [5:0] LEDC_INTR_MAP — Configures the interrupt source into one CPU interrupt.
0xC0 TWAI0_INTR_MAP — TWAI0_INTR mapping register
  [5:0] TWAI0_INTR_MAP — Configures the interrupt source into one CPU interrupt.
0xC4 TWAI0_TIMER_INTR_MAP — TWAI0_TIMER_INTR mapping register
  [5:0] TWAI0_TIMER_INTR_MAP — Configures the interrupt source into one CPU interrupt.
0xC8 TWAI1_INTR_MAP — TWAI1_INTR mapping register
  [5:0] TWAI1_INTR_MAP — Configures the interrupt source into one CPU interrupt.
0xCC TWAI1_TIMER_INTR_MAP — TWAI1_TIMER_INTR mapping register
  [5:0] TWAI1_TIMER_INTR_MAP — Configures the interrupt source into one CPU interrupt.
0xD0 USB_SERIAL_JTAG_INTR_MAP — USB_SERIAL_JTAG_INTR mapping register
  [5:0] USB_SERIAL_JTAG_INTR_MAP — Configures the interrupt source into one CPU interrupt.
0xD4 RMT_INTR_MAP — RMT_INTR mapping register
  [5:0] RMT_INTR_MAP — Configures the interrupt source into one CPU interrupt.
0xD8 I2C_EXT0_INTR_MAP — I2C_EXT0_INTR mapping register
  [5:0] I2C_EXT0_INTR_MAP — Configures the interrupt source into one CPU interrupt.
0xDC TG0_T0_INTR_MAP — TG0_T0_INTR mapping register
  [5:0] TG0_T0_INTR_MAP — Configures the interrupt source into one CPU interrupt.
0xE0 TG0_WDT_INTR_MAP — TG0_WDT_INTR mapping register
  [5:0] TG0_WDT_INTR_MAP — Configures the interrupt source into one CPU interrupt.
0xE4 TG1_T0_INTR_MAP — TG1_T0_INTR mapping register
  [5:0] TG1_T0_INTR_MAP — Configures the interrupt source into one CPU interrupt.
0xE8 TG1_WDT_INTR_MAP — TG1_WDT_INTR mapping register
  [5:0] TG1_WDT_INTR_MAP — Configures the interrupt source into one CPU interrupt.
{0xEC+4i} SYSTIMER_TARGET{i}_INTR_MAP (i=0..2) — SYSTIMER_TARGET{i}_INTR mapping register
  [5:0] SYSTIMER_TARGET{i}_INTR_MAP — Configures the interrupt source into one CPU interrupt.
0xF8 APB_ADC_INTR_MAP — APB_ADC_INTR mapping register
  [5:0] APB_ADC_INTR_MAP — Configures the interrupt source into one CPU interrupt.
0xFC PWM_INTR_MAP — PWM_INTR mapping register
  [5:0] PWM_INTR_MAP — Configures the interrupt source into one CPU interrupt.
0x100 PCNT_INTR_MAP — PCNT_INTR mapping register
  [5:0] PCNT_INTR_MAP — Configures the interrupt source into one CPU interrupt.
0x104 PARL_IO_TX_INTR_MAP — PARL_IO_TX_INTR mapping register
  [5:0] PARL_IO_TX_INTR_MAP — Configures the interrupt source into one CPU interrupt.
0x108 PARL_IO_RX_INTR_MAP — PARL_IO_RX_INTR mapping register
  [5:0] PARL_IO_RX_INTR_MAP — Configures the interrupt source into one CPU interrupt.
{0x10C+4i} DMA_IN_CH{i}_INTR_MAP (i=0..2) — DMA_IN_CH{i}_INTR mapping register
  [5:0] DMA_IN_CH{i}_INTR_MAP — Configures the interrupt source into one CPU interrupt.
{0x118+4i} DMA_OUT_CH{i}_INTR_MAP (i=0..2) — DMA_OUT_CH{i}_INTR mapping register
  [5:0] DMA_OUT_CH{i}_INTR_MAP — Configures the interrupt source into one CPU interrupt.
0x124 GPSPI2_INTR_MAP — GPSPI2_INTR mapping register
  [5:0] GPSPI2_INTR_MAP — Configures the interrupt source into one CPU interrupt.
0x128 AES_INTR_MAP — AES_INTR mapping register
  [5:0] AES_INTR_MAP — Configures the interrupt source into one CPU interrupt.
0x12C SHA_INTR_MAP — SHA_INTR mapping register
  [5:0] SHA_INTR_MAP — Configures the interrupt source into one CPU interrupt.
0x130 RSA_INTR_MAP — RSA_INTR mapping register
  [5:0] RSA_INTR_MAP — Configures the interrupt source into one CPU interrupt.
0x134 ECC_INTR_MAP — ECC_INTR mapping register
  [5:0] ECC_INTR_MAP — Configures the interrupt source into one CPU interrupt.
0x138 ECDSA_INTR_MAP — ECDSA_INTR mapping register
  [5:0] ECDSA_INTR_MAP — Configures the interrupt source into one CPU interrupt.
0x13C KM_INTR_MAP — KM_INTR mapping register
  [5:0] KM_INTR_MAP — Configures the interrupt source into one CPU interrupt.
{0x140+4i} INT_STATUS_{i} ro (i=0..2) — Status register for interrupt sources {32i} ~ {32i+31}
  [31:0] INT_STATUS_{i} — Represents the status of the interrupt sources numbered from .Each bit corresponds to one interrupt source 0:The corresponding interrupt source triggered an interrupt 1:No interrupt triggered
0x14C CLOCK_GATE — Interrupt clock gating configure register
  [0] REG_CLK_EN
0x7FC INTERRUPT_DATE reset 0x2312061 — Version control register
  [27:0] INTERRUPT_DATE
