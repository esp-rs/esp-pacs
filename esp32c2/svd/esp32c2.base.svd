# ESP32-C2 register map
Vendor: ESPRESSIF SYSTEMS (SHANGHAI) CO., LTD.; Series: ESP32 C-Series; File version: 11
CPU: RV32IMC r0p0, little endian, no MPU, no FPU, 0 interrupt priority bits
Address unit: 32 bits
Registers are 32-bit, read-write, reset 0x0 unless marked. A register's access mark holds for its fields unless they carry their own. Offsets are from the block's base; [hi:lo] are bit positions; {n}, {i} and the like mark numbered series.

## INTERRUPT_CORE0 — Interrupt Controller (Core 0)
Base 0x600C2000
0x00 WIFI_MAC_INT_MAP — register description
  [4:0] WIFI_MAC_INT_MAP — Need add description
0x04 WIFI_MAC_NMI_MAP — register description
  [4:0] WIFI_MAC_NMI_MAP — Need add description
0x08 WIFI_PWR_INT_MAP — register description
  [4:0] WIFI_PWR_INT_MAP — Need add description
0x0C WIFI_BB_INT_MAP — register description
  [4:0] WIFI_BB_INT_MAP — Need add description
0x10 BT_MAC_INT_MAP — register description
  [4:0] BT_MAC_INT_MAP — Need add description
0x14 BT_BB_INT_MAP — register description
  [4:0] BT_BB_INT_MAP — Need add description
0x18 BT_BB_NMI_MAP — register description
  [4:0] BT_BB_NMI_MAP — Need add description
0x1C LP_TIMER_INT_MAP — register description
  [4:0] LP_TIMER_INT_MAP — Need add description
0x20 COEX_INT_MAP — register description
  [4:0] COEX_INT_MAP — Need add description
0x24 BLE_TIMER_INT_MAP — register description
  [4:0] BLE_TIMER_INT_MAP — Need add description
0x28 BLE_SEC_INT_MAP — register description
  [4:0] BLE_SEC_INT_MAP — Need add description
0x2C I2C_MST_INT_MAP — register description
  [4:0] I2C_MST_INT_MAP — Need add description
0x30 APB_CTRL_INTR_MAP — register description
  [4:0] APB_CTRL_INTR_MAP — Need add description
0x34 GPIO_INTERRUPT_PRO_MAP — register description
  [4:0] GPIO_INTERRUPT_PRO_MAP — Need add description
0x38 GPIO_INTERRUPT_PRO_NMI_MAP — register description
  [4:0] GPIO_INTERRUPT_PRO_NMI_MAP — Need add description
0x3C SPI_INTR_1_MAP — register description
  [4:0] SPI_INTR_1_MAP — Need add description
0x40 SPI_INTR_2_MAP — register description
  [4:0] SPI_INTR_2_MAP — Need add description
0x44 UART_INTR_MAP — register description
  [4:0] UART_INTR_MAP — Need add description
0x48 UART1_INTR_MAP — register description
  [4:0] UART1_INTR_MAP — Need add description
0x4C LEDC_INT_MAP — register description
  [4:0] LEDC_INT_MAP — Need add description
0x50 EFUSE_INT_MAP — register description
  [4:0] EFUSE_INT_MAP — Need add description
0x54 RTC_CORE_INTR_MAP — register description
  [4:0] RTC_CORE_INTR_MAP — Need add description
0x58 I2C_EXT0_INTR_MAP — register description
  [4:0] I2C_EXT0_INTR_MAP — Need add description
0x5C TG_T0_INT_MAP — register description
  [4:0] TG_T0_INT_MAP — Need add description
0x60 TG_WDT_INT_MAP — register description
  [4:0] TG_WDT_INT_MAP — Need add description
0x64 CACHE_IA_INT_MAP — register description
  [4:0] CACHE_IA_INT_MAP — Need add description
{0x68+4i} SYSTIMER_TARGET{i}_INT_MAP (i=0..2) — register description
  [4:0] SYSTIMER_TARGET{i}_INT_MAP — Need add description
0x74 SPI_MEM_REJECT_INTR_MAP — register description
  [4:0] SPI_MEM_REJECT_INTR_MAP — Need add description
0x78 ICACHE_PRELOAD_INT_MAP — register description
  [4:0] ICACHE_PRELOAD_INT_MAP — Need add description
0x7C ICACHE_SYNC_INT_MAP — register description
  [4:0] ICACHE_SYNC_INT_MAP — Need add description
0x80 APB_ADC_INT_MAP — register description
  [4:0] APB_ADC_INT_MAP — Need add description
0x84 DMA_CH0_INT_MAP — register description
  [4:0] DMA_CH0_INT_MAP — Need add description
0x88 SHA_INT_MAP — register description
  [4:0] SHA_INT_MAP — Need add description
0x8C ECC_INT_MAP — register description
  [4:0] ECC_INT_MAP — Need add description
{0x90+4i} CPU_INTR_FROM_CPU_{i}_MAP (i=0..3) — register description
  [4:0] CPU_INTR_FROM_CPU_{i}_MAP — Need add description
0xA0 ASSIST_DEBUG_INTR_MAP — register description
  [4:0] ASSIST_DEBUG_INTR_MAP — Need add description
0xA4 CORE_0_PIF_PMS_MONITOR_VIOLATE_SIZE_INTR_MAP — register description
  [4:0] CORE_0_PIF_PMS_MONITOR_VIOLATE_SIZE_INTR_MAP — Need add description
0xA8 CACHE_CORE0_ACS_INT_MAP — register description
  [4:0] CACHE_CORE0_ACS_INT_MAP — Need add description
0xAC INTR_STATUS_REG_0 ro — register description
  [31:0] INTR_STATUS_0 — Need add description
0xB0 INTR_STATUS_REG_1 ro — register description
  [31:0] INTR_STATUS_1 — Need add description
0xB4 CLOCK_GATE reset 0x1 — register description
  [0] REG_CLK_EN — Need add description
0xB8 CPU_INT_ENABLE — register description
  [31:0] CPU_INT_ENABLE — Need add description
0xBC CPU_INT_TYPE — register description
  [31:0] CPU_INT_TYPE — Need add description
0xC0 CPU_INT_CLEAR — register description
  [31:0] CPU_INT_CLEAR — Need add description
0xC4 CPU_INT_EIP_STATUS ro — register description
  [31:0] CPU_INT_EIP_STATUS — Need add description
{0xC8+4i} CPU_INT_PRI_{i} (i=0..31) — register description
  [3:0] CPU_PRI_{i}_MAP — Need add description
0x148 CPU_INT_THRESH — register description
  [3:0] CPU_INT_THRESH — Need add description
0x7FC INTERRUPT_REG_DATE reset 0x2108190 — register description
  [27:0] INTERRUPT_REG_DATE — Need add description
