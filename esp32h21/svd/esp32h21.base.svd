# ESP32-H21 register map
Vendor: ESPRESSIF SYSTEMS (SHANGHAI) CO., LTD.; Series: ESP32 H-Series; File version: 1
CPU: RV32IMAC r0p0, little endian, no MPU, no FPU, 0 interrupt priority bits
Address unit: 32 bits
Registers are 32-bit, read-write, reset 0x0 unless marked. A register's access mark holds for its fields unless they carry their own. Offsets are from the block's base; [hi:lo] are bit positions; {n}, {i} and the like mark numbered series.

## INTERRUPT_CORE0 — Interrupt Controller (Core 0)
Base 0x60010000
0x00 INTMTX_CORE0_PMU_INTR_MAP — register description
  [4:0] INTMTX_CORE0_PMU_INTR_MAP — CORE0_PMU_INTR mapping register
0x04 INTMTX_CORE0_EFUSE_INTR_MAP — register description
  [4:0] INTMTX_CORE0_EFUSE_INTR_MAP — CORE0_EFUSE_INTR mapping register
0x08 INTMTX_CORE0_LP_RTC_TIMER_INTR_MAP — register description
  [4:0] INTMTX_CORE0_LP_RTC_TIMER_INTR_MAP — CORE0_LP_RTC_TIMER_INTR mapping register
0x0C INTMTX_CORE0_LP_BLE_TIMER_INTR_MAP — register description
  [4:0] INTMTX_CORE0_LP_BLE_TIMER_INTR_MAP — CORE0_LP_BLE_TIMER_INTR mapping register
0x10 INTMTX_CORE0_LP_WDT_INTR_MAP — register description
  [4:0] INTMTX_CORE0_LP_WDT_INTR_MAP — CORE0_LP_WDT_INTR mapping register
0x14 INTMTX_CORE0_LP_PERI_TIMEOUT_INTR_MAP — register description
  [4:0] INTMTX_CORE0_LP_PERI_TIMEOUT_INTR_MAP — CORE0_LP_PERI_TIMEOUT_INTR mapping register
0x18 INTMTX_CORE0_LP_APM_M0_INTR_MAP — register description
  [4:0] INTMTX_CORE0_LP_APM_M0_INTR_MAP — CORE0_LP_APM_M0_INTR mapping register
{0x1C+4i} INTMTX_CORE0_CPU_INTR_FROM_CPU_{i}_MAP (i=0..3) — register description
  [4:0] INTMTX_CORE0_CPU_INTR_FROM_CPU_{i}_MAP — CORE0_CPU_INTR_FROM_CPU_{i} mapping register
0x2C INTMTX_CORE0_ASSIST_DEBUG_INTR_MAP — register description
  [4:0] INTMTX_CORE0_ASSIST_DEBUG_INTR_MAP — CORE0_ASSIST_DEBUG_INTR mapping register
0x30 INTMTX_CORE0_TRACE_INTR_MAP — register description
  [4:0] INTMTX_CORE0_TRACE_INTR_MAP — CORE0_TRACE_INTR mapping register
0x34 INTMTX_CORE0_CACHE_INTR_MAP — register description
  [4:0] INTMTX_CORE0_CACHE_INTR_MAP — CORE0_CACHE_INTR mapping register
0x38 INTMTX_CORE0_CPU_PERI_TIMEOUT_INTR_MAP — register description
  [4:0] INTMTX_CORE0_CPU_PERI_TIMEOUT_INTR_MAP — CORE0_CPU_PERI_TIMEOUT_INTR mapping register
0x3C INTMTX_CORE0_BT_MAC_INTR_MAP — register description
  [4:0] INTMTX_CORE0_BT_MAC_INTR_MAP — CORE0_BT_MAC_INTR mapping register
0x40 INTMTX_CORE0_BT_BB_INTR_MAP — register description
  [4:0] INTMTX_CORE0_BT_BB_INTR_MAP — CORE0_BT_BB_INTR mapping register
0x44 INTMTX_CORE0_BT_BB_NMI_MAP — register description
  [4:0] INTMTX_CORE0_BT_BB_NMI_MAP — CORE0_BT_BB_NMI mapping register
0x48 INTMTX_CORE0_COEX_INTR_MAP — register description
  [4:0] INTMTX_CORE0_COEX_INTR_MAP — CORE0_COEX_INTR mapping register
0x4C INTMTX_CORE0_BLE_TIMER_INTR_MAP — register description
  [4:0] INTMTX_CORE0_BLE_TIMER_INTR_MAP — CORE0_BLE_TIMER_INTR mapping register
0x50 INTMTX_CORE0_BLE_SEC_INTR_MAP — register description
  [4:0] INTMTX_CORE0_BLE_SEC_INTR_MAP — CORE0_BLE_SEC_INTR mapping register
0x54 INTMTX_CORE0_ZB_MAC_INTR_MAP — register description
  [4:0] INTMTX_CORE0_ZB_MAC_INTR_MAP — CORE0_ZB_MAC_INTR mapping register
0x58 INTMTX_CORE0_GPIO_INTERRUPT_PRO_MAP — register description
  [4:0] INTMTX_CORE0_GPIO_INTERRUPT_PRO_MAP — CORE0_GPIO_INTERRUPT_PRO mapping register
0x5C INTMTX_CORE0_GPIO_INTERRUPT_PRO_NMI_MAP — register description
  [4:0] INTMTX_CORE0_GPIO_INTERRUPT_PRO_NMI_MAP — CORE0_GPIO_INTERRUPT_PRO_NMI mapping register
0x60 INTMTX_CORE0_PAU_INTR_MAP — register description
  [4:0] INTMTX_CORE0_PAU_INTR_MAP — CORE0_PAU_INTR mapping register
0x64 INTMTX_CORE0_HP_PERI_TIMEOUT_INTR_MAP — register description
  [4:0] INTMTX_CORE0_HP_PERI_TIMEOUT_INTR_MAP — CORE0_HP_PERI_TIMEOUT_INTR mapping register
{0x68+4i} INTMTX_CORE0_HP_APM_M{i}_INTR_MAP (i=0..3) — register description
  [4:0] INTMTX_CORE0_HP_APM_M{i}_INTR_MAP — CORE0_HP_APM_M{i}_INTR mapping register
0x78 INTMTX_CORE0_MSPI_INTR_MAP — register description
  [4:0] INTMTX_CORE0_MSPI_INTR_MAP — CORE0_MSPI_INTR mapping register
0x7C INTMTX_CORE0_I2S1_INTR_MAP — register description
  [4:0] INTMTX_CORE0_I2S1_INTR_MAP — CORE0_I2S1_INTR mapping register
0x80 INTMTX_CORE0_UHCI0_INTR_MAP — register description
  [4:0] INTMTX_CORE0_UHCI0_INTR_MAP — CORE0_UHCI0_INTR mapping register
0x84 INTMTX_CORE0_UART0_INTR_MAP — register description
  [4:0] INTMTX_CORE0_UART0_INTR_MAP — CORE0_UART0_INTR mapping register
0x88 INTMTX_CORE0_UART1_INTR_MAP — register description
  [4:0] INTMTX_CORE0_UART1_INTR_MAP — CORE0_UART1_INTR mapping register
0x8C INTMTX_CORE0_LEDC_INTR_MAP — register description
  [4:0] INTMTX_CORE0_LEDC_INTR_MAP — CORE0_LEDC_INTR mapping register
0x90 INTMTX_CORE0_CAN0_INTR_MAP — register description
  [4:0] INTMTX_CORE0_CAN0_INTR_MAP — CORE0_CAN0_INTR mapping register
0x94 INTMTX_CORE0_USB_INTR_MAP — register description
  [4:0] INTMTX_CORE0_USB_INTR_MAP — CORE0_USB_INTR mapping register
0x98 INTMTX_CORE0_RMT_INTR_MAP — register description
  [4:0] INTMTX_CORE0_RMT_INTR_MAP — CORE0_RMT_INTR mapping register
0x9C INTMTX_CORE0_I2C_EXT0_INTR_MAP — register description
  [4:0] INTMTX_CORE0_I2C_EXT0_INTR_MAP — CORE0_I2C_EXT0_INTR mapping register
0xA0 INTMTX_CORE0_I2C_EXT1_INTR_MAP — register description
  [4:0] INTMTX_CORE0_I2C_EXT1_INTR_MAP — CORE0_I2C_EXT1_INTR mapping register
0xA4 INTMTX_CORE0_TG0_T0_INTR_MAP — register description
  [4:0] INTMTX_CORE0_TG0_T0_INTR_MAP — CORE0_TG0_T0_INTR mapping register
0xA8 INTMTX_CORE0_TG0_WDT_INTR_MAP — register description
  [4:0] INTMTX_CORE0_TG0_WDT_INTR_MAP — CORE0_TG0_WDT_INTR mapping register
0xAC INTMTX_CORE0_TG1_T0_INTR_MAP — register description
  [4:0] INTMTX_CORE0_TG1_T0_INTR_MAP — CORE0_TG1_T0_INTR mapping register
0xB0 INTMTX_CORE0_TG1_WDT_INTR_MAP — register description
  [4:0] INTMTX_CORE0_TG1_WDT_INTR_MAP — CORE0_TG1_WDT_INTR mapping register
{0xB4+4i} INTMTX_CORE0_SYSTIMER_TARGET{i}_INTR_MAP (i=0..2) — register description
  [4:0] INTMTX_CORE0_SYSTIMER_TARGET{i}_INTR_MAP — CORE0_SYSTIMER_TARGET{i}_INTR mapping register
0xC0 INTMTX_CORE0_APB_ADC_INTR_MAP — register description
  [4:0] INTMTX_CORE0_APB_ADC_INTR_MAP — CORE0_APB_ADC_INTR mapping register
0xC4 INTMTX_CORE0_PWM_INTR_MAP — register description
  [4:0] INTMTX_CORE0_PWM_INTR_MAP — CORE0_PWM_INTR mapping register
0xC8 INTMTX_CORE0_PCNT_INTR_MAP — register description
  [4:0] INTMTX_CORE0_PCNT_INTR_MAP — CORE0_PCNT_INTR mapping register
0xCC INTMTX_CORE0_PARL_IO_TX_INTR_MAP — register description
  [4:0] INTMTX_CORE0_PARL_IO_TX_INTR_MAP — CORE0_PARL_IO_TX_INTR mapping register
0xD0 INTMTX_CORE0_PARL_IO_RX_INTR_MAP — register description
  [4:0] INTMTX_CORE0_PARL_IO_RX_INTR_MAP — CORE0_PARL_IO_RX_INTR mapping register
{0xD4+4i} INTMTX_CORE0_DMA_IN_CH{i}_INTR_MAP (i=0..2) — register description
  [4:0] INTMTX_CORE0_DMA_IN_CH{i}_INTR_MAP — CORE0_DMA_IN_CH{i}_INTR mapping register
{0xE0+4i} INTMTX_CORE0_DMA_OUT_CH{i}_INTR_MAP (i=0..2) — register description
  [4:0] INTMTX_CORE0_DMA_OUT_CH{i}_INTR_MAP — CORE0_DMA_OUT_CH{i}_INTR mapping register
0xEC INTMTX_CORE0_GPSPI2_INTR_MAP — register description
  [4:0] INTMTX_CORE0_GPSPI2_INTR_MAP — CORE0_GPSPI2_INTR mapping register
0xF0 INTMTX_CORE0_AES_INTR_MAP — register description
  [4:0] INTMTX_CORE0_AES_INTR_MAP — CORE0_AES_INTR mapping register
0xF4 INTMTX_CORE0_SHA_INTR_MAP — register description
  [4:0] INTMTX_CORE0_SHA_INTR_MAP — CORE0_SHA_INTR mapping register
0xF8 INTMTX_CORE0_RSA_INTR_MAP — register description
  [4:0] INTMTX_CORE0_RSA_INTR_MAP — CORE0_RSA_INTR mapping register
0xFC INTMTX_CORE0_ECC_INTR_MAP — register description
  [4:0] INTMTX_CORE0_ECC_INTR_MAP — CORE0_ECC_INTR mapping register
0x100 INTMTX_CORE0_ECDSA_INTR_MAP — register description
  [4:0] INTMTX_CORE0_ECDSA_INTR_MAP — CORE0_ECDSA_INTR mapping register
{0x104+4i} INTMTX_CORE0_INT_STATUS_REG_{i} ro (i=0..2) — register description
  [31:0] INTMTX_CORE0_INT_STATUS_{i} — Status register for interrupt sources {32i}~{32i+31} mapping register
0x110 INTMTX_CORE0_CLOCK_GATE reset 0x1 — register description
  [0] INTMTX_CORE0_REG_CLK_EN — Clock register
0x7FC INTMTX_CORE0_INTERRUPT_REG_DATE reset 0x2209150 — register description
  [27:0] INTMTX_CORE0_INTERRUPT_REG_DATE — Version control register
