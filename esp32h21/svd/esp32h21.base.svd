# ESP32-H21 register map
Vendor: ESPRESSIF SYSTEMS (SHANGHAI) CO., LTD.; Series: ESP32 H-Series; File version: 1
32-bit RISC-V MCU & Bluetooth 5 (LE) & IEEE 802.15.4
CPU: RV32IMAC r0p0, little endian, no MPU, no FPU, 0 interrupt priority bits
Address unit: 32 bits
Registers are 32-bit, read-write, reset 0x0 unless marked. A register's access mark holds for its fields unless they carry their own. Offsets are from the block's base; lines under a group give offsets from that group; [hi:lo] are bit positions; {n}, {i} and the like mark numbered series; 'fields as' and 'values as' point back to an identical list; <NAME> marks a mode.

## Memory map
0x60000000 UART0 size 0x98 — UART (Universal Asynchronous Receiver-Transmitter) Controller 0
0x60001000 UART1 size 0x98 — UART (Universal Asynchronous Receiver-Transmitter) Controller 1
0x60002000 SPI0 size 0x224 — SPI (Serial Peripheral Interface) Controller 0
0x60003000 SPI1 size 0xB0 — SPI (Serial Peripheral Interface) Controller 1
0x60004000 I2C0 size 0x8C — I2C (Inter-Integrated Circuit) Controller 0
0x60005000 I2C1 size 0x8C — I2C (Inter-Integrated Circuit) Controller 1
0x60006000 UHCI0 size 0x84 — Universal Host Controller Interface 0
0x60007000 RMT size 0x78 — Remote Control
0x60008000 LEDC size 0x154 — LED Control PWM (Pulse Width Modulation)
0x60009000 TIMG0 size 0x68 — Timer Group 0
0x6000A000 TIMG1 size 0x68 — Timer Group 1
0x6000B000 SYSTIMER size 0x90 — System Timer
0x6000C000 TWAI0 size 0x80 — Two-Wire Automotive Interface
0x6000D000 I2S0 size 0x60 — I2S (Inter-IC Sound) Controller 0
0x6000E000 APB_SARADC size 0x70 — SAR (Successive Approximation Register) Analog-to-Digital Converter
0x6000F000 USB_DEVICE size 0x78 — Full-speed USB Serial/JTAG Controller
0x60010000 INTERRUPT_CORE0 size 0x118 — Interrupt Controller (Core 0)
0x60012000 PCNT size 0x78 — Pulse Count Controller
0x60013000 SOC_ETM size 0x1B0 — Event Task Matrix
0x60014000 MCPWM0 size 0x130 — Motor Control Pulse-Width Modulation 0
0x60015000 PARL_IO size 0x54 — Parallel IO Controller
0x60019000 PVT size 0x1F4 — PVT Peripheral
0x60080000 DMA size 0x1A4 — DMA (Direct Memory Access) Controller
0x60081000 SPI2 size 0x98 — SPI (Serial Peripheral Interface) Controller 2
0x60088000 AES size 0xC8 — AES (Advanced Encryption Standard) Accelerator
0x60089000 SHA size 0xB0 — SHA (Secure Hash Algorithm) Accelerator
0x6008A000 RSA size 0x74 — RSA (Rivest Shamir Adleman) Accelerator
0x6008B000 ECC size 0xD8 — ECC (ECC Hardware Accelerator)
0x6008C000 DS size 0xA5C — Digital Signature
0x6008D000 HMAC size 0xA4 — HMAC (Hash-based Message Authentication Code) Accelerator
0x6008E000 ECDSA size 0xF8 — ECDSA (Elliptic Curve Digital Signature Algorithm) Accelerator
0x60090000 IO_MUX size 0x6C — Input/Output Multiplexer
0x60091000 GPIO size 0x29C — General Purpose Input/Output
0x60091E00 GPIO_SD size 0x90 — Sigma-Delta Modulation
0x60092000 MEM_MONITOR size 0x30 — MEM_MONITOR Peripheral
0x60093000 PAU size 0x2C — PAU Peripheral
0x60095000 HP_SYS size 0x50 — High-Power System
0x60096000 PCR size 0x164 — PCR Peripheral
0x60098000 TEE size 0x88 — TEE Peripheral
0x60099000 HP_APM size 0x114 — HP_APM Peripheral
0x60099800 LP_APM0 size 0x54 — LP_APM0 Peripheral
0x600B0000 PMU size 0x1C4 — PMU Peripheral
0x600B0400 LP_CLKRST size 0x34 — LP_CLKRST Peripheral
0x600B0C00 LP_TIMER size 0x34 — Low-power Timer
0x600B1000 LP_AON size 0x6C — LP_AON Peripheral
0x600B1C00 LP_WDT size 0x3C — Low-power Watchdog Timer
0x600B2800 LP_PERI size 0x38 — LP_PERI Peripheral
0x600B2C00 LP_ANA size 0x44 — LP_ANA Peripheral
0x600B3800 LP_APM size 0x3C — Low-power Access Permission Management Controller
0x600B4000 EFUSE size 0x3D8 — eFuse Controller
0x600C0000 TRACE size 0x30 — RISC-V Trace Encoder
0x600C2000 ASSIST_DEBUG size 0x80 — Debug Assist
0x600C5000 INTPRI size 0xB8 — INTPRI Peripheral
0x600C8000 CACHE size 0x3F4 — CACHE Peripheral

## Interrupts
0 PMU (INTERRUPT_CORE0)
1 EFUSE (INTERRUPT_CORE0)
2 LP_RTC_TIMER (INTERRUPT_CORE0)
3 LP_BLE_TIMER (INTERRUPT_CORE0)
4 LP_WDT (INTERRUPT_CORE0)
5 LP_PERI_TIMEOUT (INTERRUPT_CORE0)
6 LP_APM_M0 (INTERRUPT_CORE0)
7 FROM_CPU_INTR0 (INTERRUPT_CORE0)
8 FROM_CPU_INTR1 (INTERRUPT_CORE0)
9 FROM_CPU_INTR2 (INTERRUPT_CORE0)
10 FROM_CPU_INTR3 (INTERRUPT_CORE0)
11 ASSIST_DEBUG (INTERRUPT_CORE0)
12 TRACE (INTERRUPT_CORE0)
13 CACHE (INTERRUPT_CORE0)
14 CPU_PERI_TIMEOUT (INTERRUPT_CORE0)
15 BT_MAC (INTERRUPT_CORE0)
16 BT_BB (INTERRUPT_CORE0)
17 BT_BB_NMI (INTERRUPT_CORE0)
18 COEX (INTERRUPT_CORE0)
19 BLE_TIMER (INTERRUPT_CORE0)
20 BLE_SEC (INTERRUPT_CORE0)
21 ZB_MAC (INTERRUPT_CORE0)
22 GPIO (INTERRUPT_CORE0)
23 GPIO_NMI (INTERRUPT_CORE0)
24 PAU (INTERRUPT_CORE0)
25 HP_PERI_TIMEOUT (INTERRUPT_CORE0)
26 HP_APM_M0 (INTERRUPT_CORE0)
27 HP_APM_M1 (INTERRUPT_CORE0)
28 HP_APM_M2 (INTERRUPT_CORE0)
29 HP_APM_M3 (INTERRUPT_CORE0)
30 MSPI (INTERRUPT_CORE0)
31 I2S0 (INTERRUPT_CORE0)
32 UHCI0 (INTERRUPT_CORE0)
33 UART0 (INTERRUPT_CORE0)
34 UART1 (INTERRUPT_CORE0)
35 LEDC (INTERRUPT_CORE0)
36 TWAI0 (INTERRUPT_CORE0)
37 USB_DEVICE (INTERRUPT_CORE0)
38 RMT (INTERRUPT_CORE0)
39 I2C_EXT0 (INTERRUPT_CORE0)
40 I2C_EXT1 (INTERRUPT_CORE0)
41 TG0_T0 (INTERRUPT_CORE0)
42 TG0_WDT (INTERRUPT_CORE0)
43 TG1_T0 (INTERRUPT_CORE0)
44 TG1_WDT (INTERRUPT_CORE0)
45 SYSTIMER_TARGET0 (INTERRUPT_CORE0)
46 SYSTIMER_TARGET1 (INTERRUPT_CORE0)
47 SYSTIMER_TARGET2 (INTERRUPT_CORE0)
48 APB_ADC (INTERRUPT_CORE0)
49 MCPWM0 (INTERRUPT_CORE0)
49 TEMPERATURE_SENSOR (INTERRUPT_CORE0)
50 PCNT (INTERRUPT_CORE0)
51 PARL_IO_TX (INTERRUPT_CORE0)
52 PARL_IO_RX (INTERRUPT_CORE0)
53 DMA_IN_CH0 (INTERRUPT_CORE0)
54 DMA_IN_CH1 (INTERRUPT_CORE0)
55 DMA_IN_CH2 (INTERRUPT_CORE0)
56 DMA_OUT_CH0 (INTERRUPT_CORE0)
57 DMA_OUT_CH1 (INTERRUPT_CORE0)
58 DMA_OUT_CH2 (INTERRUPT_CORE0)
59 GPSPI2 (INTERRUPT_CORE0)
60 AES (INTERRUPT_CORE0)
61 SHA (INTERRUPT_CORE0)
62 RSA (INTERRUPT_CORE0)
63 ECC (INTERRUPT_CORE0)
64 ECDSA (INTERRUPT_CORE0)

## Licence text in the file
Copyright 2026 Espressif Systems (Shanghai) PTE LTD Licensed under the Apache License, Version 2.0 (the "License"); you may not use this file except in compliance with the License. You may obtain a copy of the License at http://www.apache.org/licenses/LICENSE-2.0 Unless required by applicable law or agreed to in writing, software distributed under the License is distributed on an "AS IS" BASIS, WITHOUT WARRANTIES OR CONDITIONS OF ANY KIND, either express or implied. See the License for the specific language governing permissions and limitations under the License.
